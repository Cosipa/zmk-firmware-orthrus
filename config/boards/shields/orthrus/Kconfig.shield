## config/boards/shields/orthrus/Kconfig.shield
```kconfig
config SHIELD_ORTHRUS_LEFT
    def_bool $(shields_list_contains,orthrus_left)

config SHIELD_ORTHRUS_RIGHT
    def_bool $(shields_list_contains,orthrus_right)
```
